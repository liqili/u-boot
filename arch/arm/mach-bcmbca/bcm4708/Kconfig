## arch/arm/mach-bcmbca/bcm4708/Kconfig
```kconfig
# SPDX-License-Identifier: GPL-2.0+
#
# (C) Copyright 2022 Broadcom Ltd
#

if BCM4708

config TARGET_BCM4708
	bool "Broadcom 4708 Reference Board"
	depends on ARCH_BCMBCA

config SYS_SOC
	default "bcm4708"

source "board/broadcom/bcm4708/Kconfig"

endif
```

## arch/arm/mach-bcmbca/bcm6750/Kconfig
```kconfig
# SPDX-License-Identifier: GPL-2.0+
#
# (C) Copyright 2022 Broadcom Ltd
#

if BCM6750

config TARGET_BCM96750REF1
	bool "Broadcom 6750 Reference Board"
	depends on ARCH_BCMBCA

config SYS_SOC
	default "bcm6750"

source "board/broadcom/bcm96750ref1/Kconfig"

endif
```

## board/broadcom/bcm4708/Kconfig
```kconfig
if TARGET_BCM4708

config SYS_VENDOR
	default "broadcom"

config SYS_BOARD
	default "bcm4708"

config SYS_CONFIG_NAME
	default "broadcom_bcm4708"

endif
```

## board/broadcom/bcm96750ref1/Kconfig
```kconfig
if TARGET_BCM96750REF1

config SYS_VENDOR
	default "broadcom"

config SYS_BOARD
	default "bcm96750ref1"

config SYS_CONFIG_NAME
	default "broadcom_bcm96750ref1"

endif
```

## configs/bcm4708_defconfig
```kconfig
CONFIG_ARM=y
CONFIG_ARCH_BCMBCA=y
CONFIG_BCM4708=y
CONFIG_TARGET_BCM4708=y
CONFIG_DEFAULT_DEVICE_TREE="bcm4708"
CONFIG_IDENT_STRING=" Broadcom BCM4708"
CONFIG_TEXT_BASE=0x00008000
CONFIG_SYS_MALLOC_LEN=0x2000000
CONFIG_SYS_MALLOC_F_LEN=0x8000
CONFIG_NR_DRAM_BANKS=2
CONFIG_HAS_CUSTOM_SYS_INIT_SP_ADDR=y
CONFIG_CUSTOM_SYS_INIT_SP_ADDR=0x00100000
CONFIG_SYS_LOAD_ADDR=0x00008000
CONFIG_ENV_VARS_UBOOT_CONFIG=y
# CONFIG_BOOTSTD is not set
CONFIG_BOOTDELAY=1
CONFIG_AUTOBOOT_KEYED=y
CONFIG_AUTOBOOT_PROMPT="Boot Netgear system in %d seconds\n"
CONFIG_OF_BOARD_SETUP=y
CONFIG_OF_STDOUT_VIA_ALIAS=y
CONFIG_USE_BOOTCOMMAND=y
CONFIG_BOOTCOMMAND="run bootcmd_dlink_dir8xxl"
CONFIG_DISPLAY_BOARDINFO_LATE=y
CONFIG_HUSH_PARSER=y
CONFIG_SYS_MAXARGS=64
CONFIG_SYS_BOOTM_LEN=0x2000000
CONFIG_CMD_CACHE=y
CONFIG_OF_EMBED=y
CONFIG_CLK=y
CONFIG_MTD=y
CONFIG_NAND=y
CONFIG_NAND_BRCMNAND=y
CONFIG_MTD_SPI_NAND=y
CONFIG_LZMA=y

CONFIG_CMD_MTD=y
CONFIG_CMD_NAND=y
CONFIG_CMD_FS_GENERIC=y
CONFIG_CMD_MTDPARTS=y
CONFIG_CMD_UBI=y
CONFIG_DM_MTD=y
CONFIG_SYS_NAND_ONFI_DETECTION=y
# CONFIG_EFI_LOADER is not set
```

## configs/bcm96750_defconfig
```kconfig
CONFIG_ARM=y
CONFIG_ARCH_BCMBCA=y
CONFIG_SKIP_LOWLEVEL_INIT=y
CONFIG_BCM6750=y
CONFIG_TEXT_BASE=0x01000000
CONFIG_ENV_SIZE=0x20000
CONFIG_DM_GPIO=y
CONFIG_NR_DRAM_BANKS=1
# CONFIG_ARMV7_LPAE=y
CONFIG_TARGET_BCM96750REF1=y
CONFIG_ENV_VARS_UBOOT_CONFIG=y
CONFIG_SYS_LOAD_ADDR=0x01000000
CONFIG_FIT=y
CONFIG_FIT_SIGNATURE=y
CONFIG_FIT_ENABLE_RSASSA_PSS_SUPPORT=y
CONFIG_FIT_CIPHER=y
CONFIG_FIT_VERBOSE=y
CONFIG_LEGACY_IMAGE_FORMAT=y
CONFIG_OF_STDOUT_VIA_ALIAS=y
CONFIG_SILENT_CONSOLE=y
CONFIG_SYS_CONSOLE_IS_IN_ENV=y
CONFIG_SUPPORT_RAW_INITRD=y
CONFIG_HUSH_PARSER=y
# CONFIG_AUTOBOOT is not set
# CONFIG_CMD_BOOTD is not set
# CONFIG_BOOTM_NETBSD is not set
# CONFIG_BOOTM_PLAN9 is not set
# CONFIG_BOOTM_RTEMS is not set
# CONFIG_BOOTM_VXWORKS is not set
# CONFIG_CMD_ELF is not set
# CONFIG_CMD_XIMG is not set
# CONFIG_CMD_EXPORTENV is not set
# CONFIG_CMD_IMPORTENV is not set
# CONFIG_CMD_EDITENV is not set
# CONFIG_CMD_SAVEENV is not set
# CONFIG_CMD_ENV_EXISTS is not set
# CONFIG_CMD_CRC32 is not set
CONFIG_CMD_MEMINFO=y
CONFIG_CMD_CLK=y
CONFIG_CMD_GPIO=y
# CONFIG_CMD_LOADS is not set
CONFIG_CMD_MTD=y
CONFIG_CMD_NAND=y
CONFIG_CMD_WDT=y
# CONFIG_CMD_SETEXPR is not set
CONFIG_CMD_CACHE=y
# CONFIG_CMD_MISC is not set
CONFIG_CMD_MTDPARTS=y
CONFIG_CMD_UBI=y
# CONFIG_CMD_UBIFS is not set
CONFIG_DEFAULT_DEVICE_TREE="bcm96750ref1"
# CONFIG_NET is not set
CONFIG_CLK=y
CONFIG_BCM6345_GPIO=y
# CONFIG_INPUT is not set
# CONFIG_MMC is not set
CONFIG_MTD=y
CONFIG_DM_MTD=y
# CONFIG_MTD_RAW_NAND=y
CONFIG_NAND_BRCMNAND=y
CONFIG_NAND_BRCMNAND_6750=y
# CONFIG_RAM_ROCKCHIP_DEBUG is not set
CONFIG_SPECIFY_CONSOLE_INDEX=y
CONFIG_DM_SERIAL=y
CONFIG_PL01X_SERIAL=y
CONFIG_SYSRESET=y
CONFIG_SYSRESET_WATCHDOG=y
CONFIG_WDT_BCM6345=y
CONFIG_REGEX=y
# CONFIG_EFI_LOADER is not set
```
